## drivers/led/Kconfig
```kconfig
menu "AW20216S LED driver"
    config AW20216S
        bool "Enable AW20216S LED driver"
        default y
        depends on LED
        depends on SPI
        depends on GPIO
endmenu
```
